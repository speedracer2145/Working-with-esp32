## LED s and Push Buttons/components/blink/Kconfig.projbuild
```kconfig
menu "Blink Configuration"
  config BLINK_ON_TIME
    int "Blink on time (ms)"
    default 1000
    help
      Time in milliseconds that the LED is on.
  
  config BLINK_OFF_TIME
    int "Blink off time (ms)"
    default 1000
    help
      Time in milliseconds that the LED is off.
endmenu
```

## Task Creation and priorities/main/Kconfig.projbuild
```kconfig
menu "Display Settings"

  config COUNTING_DELAY
  int "Delay for counting (ms)"
  default 500

endmenu
```

## Working with Ultrasound sensors/DisplayVelocity/components/cray_wifi/Kconfig.projbuild
```kconfig
menu "WiFi Configuration"
  config ESP_WiFi_SSID
  string "WiFi SSID"
  default "isaacs-hotspot"
  help
      Provide the WiFi's SSID where the ESP connects to.
  
  config ESP_WiFi_PASSWORD
  string "WiFi Password"
  default "isaacs-hotspot"
  help
      Provide the WiFi's SSID where the ESP connects to.

  config ESP_WiFi_MAX_RETRY
  int "WiFi Retry Attempts"
  range 1 10
  default 5
  help
      Defines the number of tries to connect to the AP.

  config ESP_WiFi_DISCONNECT_ONLY_DISABLE
  int "Disable DISCONNECT_ONLY directives?"
  range 0 1
  default 1
  help
      Defines if the WiFi disconnects from the AP during the execution. 
      This is intented for testing purposes only.
endmenu
```

## Working with oled/main/Kconfig.projbuild
```kconfig
menu "Display Settings"

  config DISPLAY_DELAY
  int "Delay for display updates (ms)"
  default 2000

  config COUNTING_DELAY
  int "Delay for counting (ms)"
  default 500

endmenu
```
